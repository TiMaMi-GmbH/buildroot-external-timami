## Config.in
```kconfig
source "$BR2_EXTERNAL_TIMAMI_NET_PATH/package/dotnet-runtime/Config.in"
source "$BR2_EXTERNAL_TIMAMI_NET_PATH/package/dotnet-runtime-asp-net/Config.in"
source "$BR2_EXTERNAL_TIMAMI_NET_PATH/package/avalonia-example/Config.in"
```

## configs/raspberrypi3_64_dotnet_defconfig
```kconfig
BR2_aarch64=y
BR2_ARM_FPU_VFPV4=y
BR2_PACKAGE_HOST_LINUX_HEADERS_CUSTOM_5_10=y
BR2_TOOLCHAIN_BUILDROOT_CXX=y
BR2_ROOTFS_DEVICE_CREATION_DYNAMIC_EUDEV=y
BR2_TARGET_GENERIC_ROOT_PASSWD="root"
BR2_SYSTEM_DHCP="eth0"
BR2_ROOTFS_POST_BUILD_SCRIPT="board/raspberrypi3-64/post-build.sh"
BR2_ROOTFS_POST_IMAGE_SCRIPT="board/raspberrypi3-64/post-image.sh"
BR2_LINUX_KERNEL=y
BR2_LINUX_KERNEL_CUSTOM_TARBALL=y
BR2_LINUX_KERNEL_CUSTOM_TARBALL_LOCATION="$(call github,raspberrypi,linux,0b54dbda3cca2beb51e236a25738784e90853b64)/linux-0b54dbda3cca2beb51e236a25738784e90853b64.tar.gz"
BR2_LINUX_KERNEL_DEFCONFIG="bcmrpi3"
BR2_LINUX_KERNEL_DTS_SUPPORT=y
BR2_LINUX_KERNEL_INTREE_DTS_NAME="broadcom/bcm2710-rpi-3-b broadcom/bcm2710-rpi-3-b-plus broadcom/bcm2837-rpi-3-b"
BR2_LINUX_KERNEL_NEEDS_HOST_OPENSSL=y
BR2_PACKAGE_DEJAVU=y
BR2_PACKAGE_MESA3D=y
BR2_PACKAGE_MESA3D_GALLIUM_DRIVER_VC4=y
BR2_PACKAGE_MESA3D_OPENGL_ES=y
BR2_PACKAGE_RPI_FIRMWARE=y
BR2_PACKAGE_RPI_FIRMWARE_BOOTCODE_BIN=y
BR2_PACKAGE_RPI_FIRMWARE_VARIANT_PI=y
BR2_PACKAGE_RPI_FIRMWARE_CONFIG_FILE="$(BR2_EXTERNAL_TIMAMI_NET_PATH)/board/raspberrypi3-64/config_3_64bit_opengl.txt"
BR2_PACKAGE_RPI_USERLAND=y
BR2_PACKAGE_FONTCONFIG=y
BR2_PACKAGE_LIBINPUT=y
BR2_PACKAGE_DROPBEAR=y
BR2_PACKAGE_NGINX=y
BR2_PACKAGE_HTOP=y
BR2_PACKAGE_NANO=y
BR2_TARGET_ROOTFS_EXT2=y
BR2_TARGET_ROOTFS_EXT2_4=y
BR2_TARGET_ROOTFS_EXT2_SIZE="512M"
# BR2_TARGET_ROOTFS_TAR is not set
BR2_PACKAGE_HOST_DOSFSTOOLS=y
BR2_PACKAGE_HOST_GENIMAGE=y
BR2_PACKAGE_HOST_MTOOLS=y
BR2_PACKAGE_DOTNET_RUNTIME_ASP_NET=y
BR2_PACKAGE_AVALONIA_EXAMPLE=y
```

## package/avalonia-example/Config.in
```kconfig
config BR2_PACKAGE_AVALONIA_EXAMPLE
	bool "avalonia-example"
	depends on BR2_PACKAGE_DOTNET_RUNTIME || BR2_PACKAGE_DOTNET_RUNTIME_ASP_NET
	help
	  Example for Avalonia UI framebuffer application
```

## package/dotnet-runtime-asp-net/Config.in
```kconfig
config BR2_PACKAGE_DOTNET_RUNTIME_ASP_NET
	bool "dotnet-runtime-asp-net"
	depends on BR2_TOOLCHAIN_USES_GLIBC || BR2_TOOLCHAIN_USES_MUSL
	depends on BR2_TOOLCHAIN_HAS_THREADS
	select BR2_PACKAGE_LIBZLIB
	select BR2_PACKAGE_OPENSSL
	select BR2_PACKAGE_LIBCURL
	select BR2_PACKAGE_ICU
	help
	  ASP.NET Core Runtime (v7.0.14) - Linux ARM32 binaries

	  https://dotnet.microsoft.com/en-us/download/dotnet/7.0
```

## package/dotnet-runtime/Config.in
```kconfig
comment "dotnet-runtime needs a toolchain w/ glibc or musl"
	depends on !BR2_TOOLCHAIN_USES_GLIBC && !BR2_TOOLCHAIN_USES_MUSL

comment "dotnet-runtime needs a toolchain w/ threads"
	depends on BR2_TOOLCHAIN_USES_GLIBC || BR2_TOOLCHAIN_USES_MUSL
	depends on !BR2_TOOLCHAIN_HAS_THREADS

config BR2_PACKAGE_DOTNET_RUNTIME
	bool "dotnet-runtime"
	depends on BR2_TOOLCHAIN_USES_GLIBC || BR2_TOOLCHAIN_USES_MUSL
	depends on BR2_TOOLCHAIN_HAS_THREADS
	select BR2_PACKAGE_LIBZLIB
	select BR2_PACKAGE_OPENSSL
	select BR2_PACKAGE_LIBCURL
	select BR2_PACKAGE_ICU
	help
	  .NET 7.0 Runtime (v7.0.14) - Linux ARM32 binaries

	  https://dotnet.microsoft.com/en-us/download/dotnet/7.0
```
